/**
 * @cliArgs --board "/boards/LAUNCHXL_F28379D" --context "CPU1" --product "C2000WARE@5.02.00.00"
 * @versions {"tool":"1.20.0+3587"}
 */

/**
 * Import the modules used in this configuration.
 */
const i2c  = scripting.addModule("/driverlib/i2c.js", {}, false);
const i2c1 = i2c.addInstance();

/**
 * Write custom configuration values to the imported modules.
 */
i2c1.$name                 = "myI2C0";
i2c1.bitRate               = 100000;
i2c1.duty                  = "I2C_DUTYCYCLE_50";
i2c1.initialMode           = "RECEIVE_MODE";
i2c1.bitCount              = "I2C_BITCOUNT_8";
i2c1.dataCount             = 2;
i2c1.targetAddress         = 0x50;
i2c1.enabledInterrupts     = ["I2C_INT_ADDR_TARGET","I2C_INT_ARB_LOST","I2C_INT_NO_ACK","I2C_INT_STOP_CONDITION"];
i2c1.enabledFIFOInterrupts = ["I2C_INT_RXFF","I2C_INT_TXFF"];
i2c1.ownAddress            = 0x60;
i2c1.i2c.sdaPin.$assign    = "boosterpack1.10";
i2c1.i2c.sclPin.$assign    = "boosterpack1.9";
scripting.suppress("Connected to hardware,@@@.+?@@@ is connected to I2CA BP on the LaunchPad F28379D\\. Consider selecting it in \'use hardware\' above\\. @@@.+?@@@", i2c1.i2c, "sdaPin");
scripting.suppress("Connected to hardware,@@@.+?@@@ is connected to I2CA BP on the LaunchPad F28379D\\. Consider selecting it in \'use hardware\' above\\. @@@.+?@@@", i2c1.i2c, "sclPin");

/**
 * Pinmux solution for unlocked pins/peripherals. This ensures that minor changes to the automatic solver in a future
 * version of the tool will not impact the pinmux you originally saw.  These lines can be completely deleted in order to
 * re-solve from scratch.
 */
i2c1.i2c.$suggestSolution = "I2CA";
